#include "dasmolle.dtsi"

&kscan0 {
    input-gpios = <
      /* Row 0 */
      &gpio1  2 (GPIO_ACTIVE_LOW | GPIO_PULL_UP)
      &gpio0 29 (GPIO_ACTIVE_LOW | GPIO_PULL_UP)
      &gpio0 24 (GPIO_ACTIVE_LOW | GPIO_PULL_UP)
      &gpio0 31 (GPIO_ACTIVE_LOW | GPIO_PULL_UP)
      &gpio0  6 (GPIO_ACTIVE_LOW | GPIO_PULL_UP)

      /* Row 1 */
      &gpio1 13 (GPIO_ACTIVE_LOW | GPIO_PULL_UP)
      &gpio1  1 (GPIO_ACTIVE_LOW | GPIO_PULL_UP)
      &gpio1 15 (GPIO_ACTIVE_LOW | GPIO_PULL_UP)
      &gpio0 22 (GPIO_ACTIVE_LOW | GPIO_PULL_UP)
      &gpio0  2 (GPIO_ACTIVE_LOW | GPIO_PULL_UP)

      /* Row 2 */
      &gpio0  9 (GPIO_ACTIVE_LOW | GPIO_PULL_UP)
      &gpio0 10 (GPIO_ACTIVE_LOW | GPIO_PULL_UP)
      &gpio0 11 (GPIO_ACTIVE_LOW | GPIO_PULL_UP)
      &gpio1 11 (GPIO_ACTIVE_LOW | GPIO_PULL_UP)
      &gpio1  0 (GPIO_ACTIVE_LOW | GPIO_PULL_UP)

      /* Row 3 */
      &gpio1  7 (GPIO_ACTIVE_LOW | GPIO_PULL_UP)
      &gpio1  6 (GPIO_ACTIVE_LOW | GPIO_PULL_UP)
      &gpio1  4 (GPIO_ACTIVE_LOW | GPIO_PULL_UP)
  >;
};


&default_transform {
	col-offset = <18>;
};
