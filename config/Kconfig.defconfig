## config/Kconfig.defconfig
```kconfig
if SHIELD_DASMOLLE_LEFT

config ZMK_KEYBOARD_NAME
	default "Dasmolle"

config ZMK_SPLIT_ROLE_CENTRAL
	default y

endif

if SHIELD_DASMOLLE_LEFT || SHIELD_DASMOLLE_RIGHT

config ZMK_SPLIT
	default y

endif
```

## config/Kconfig.shield
```kconfig
config SHIELD_DASMOLLE_LEFT
	def_bool $(shields_list_contains,dasmolle_left)

config SHIELD_DASMOLLE_RIGHT
	def_bool $(shields_list_contains,dasmolle_right)
```
